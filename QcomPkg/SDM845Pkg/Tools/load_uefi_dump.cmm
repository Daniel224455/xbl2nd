;============================================================================
;  Name:
;    load_uefi_dump.cmm
;
;  Description:
;     Load UEFI crashdumps to T32 simulator
;
; Copyright (c) 2016 Qualcomm Technologies Incorporated.
; All Rights Reserved.
; Qualcomm Technologies Confidential and Proprietary
;
;----------------------------------------------------------------------------
;============================================================================
;
;                        EDIT HISTORY FOR MODULE

;
;when         who     what, where, why
;----------   ---     ----------------------------------------------------------
;2016-10-14   ai      Initial Version
;============================================================================;

ENTRY &DumpPath
  
  ; Sanity check - no argument
  if ("&DumpPath"=="")
  (
    dialog.ok "Argument required!" "load_uefi_dump.cmm <path>"
    end
  )
  
  ; Sanity check - incorrect argument
  &LoadCmmPath="&DumpPath/load.cmm"
  if (os.access("&LoadCmmPath", "r")!=TRUE())
  (
    dialog.ok "&DumpPath" "does not contain load.cmm!"
    end
  )
  
  ; Execute load script
  &CwDir=os.ppd()
  sys.u
  cd.do &LoadCmmPath
  
  ; Load UEFI symbols
  cd &CwDir
  do symbol_Load.cmm
  
  ; EL1h
  r.s M 0x05
  
  ; nsec
  r.s NS 1
  
  ; Restore GPRS
  r.s   X0 data.quad(v.address("(*((*(\\Sec\Global\UefiInfoBlockPtr)).CrashContext.SystemContextAArch64)).X0"))
  r.s   X1 data.quad(v.address("(*((*(\\Sec\Global\UefiInfoBlockPtr)).CrashContext.SystemContextAArch64)).X1"))
  r.s   X2 data.quad(v.address("(*((*(\\Sec\Global\UefiInfoBlockPtr)).CrashContext.SystemContextAArch64)).X2"))
  r.s   X3 data.quad(v.address("(*((*(\\Sec\Global\UefiInfoBlockPtr)).CrashContext.SystemContextAArch64)).X3"))
  r.s   X4 data.quad(v.address("(*((*(\\Sec\Global\UefiInfoBlockPtr)).CrashContext.SystemContextAArch64)).X4"))
  r.s   X5 data.quad(v.address("(*((*(\\Sec\Global\UefiInfoBlockPtr)).CrashContext.SystemContextAArch64)).X5"))
  r.s   X6 data.quad(v.address("(*((*(\\Sec\Global\UefiInfoBlockPtr)).CrashContext.SystemContextAArch64)).X6"))
  r.s   X7 data.quad(v.address("(*((*(\\Sec\Global\UefiInfoBlockPtr)).CrashContext.SystemContextAArch64)).X7"))
  r.s   X8 data.quad(v.address("(*((*(\\Sec\Global\UefiInfoBlockPtr)).CrashContext.SystemContextAArch64)).X8"))
  r.s   X9 data.quad(v.address("(*((*(\\Sec\Global\UefiInfoBlockPtr)).CrashContext.SystemContextAArch64)).X9"))
  r.s  X10 data.quad(v.address("(*((*(\\Sec\Global\UefiInfoBlockPtr)).CrashContext.SystemContextAArch64)).X10"))
  r.s  X11 data.quad(v.address("(*((*(\\Sec\Global\UefiInfoBlockPtr)).CrashContext.SystemContextAArch64)).X11"))
  r.s  X12 data.quad(v.address("(*((*(\\Sec\Global\UefiInfoBlockPtr)).CrashContext.SystemContextAArch64)).X12"))
  r.s  X13 data.quad(v.address("(*((*(\\Sec\Global\UefiInfoBlockPtr)).CrashContext.SystemContextAArch64)).X13"))
  r.s  X14 data.quad(v.address("(*((*(\\Sec\Global\UefiInfoBlockPtr)).CrashContext.SystemContextAArch64)).X14"))
  r.s  X15 data.quad(v.address("(*((*(\\Sec\Global\UefiInfoBlockPtr)).CrashContext.SystemContextAArch64)).X15"))
  r.s  X16 data.quad(v.address("(*((*(\\Sec\Global\UefiInfoBlockPtr)).CrashContext.SystemContextAArch64)).X16"))
  r.s  X17 data.quad(v.address("(*((*(\\Sec\Global\UefiInfoBlockPtr)).CrashContext.SystemContextAArch64)).X17"))
  r.s  X18 data.quad(v.address("(*((*(\\Sec\Global\UefiInfoBlockPtr)).CrashContext.SystemContextAArch64)).X18"))
  r.s  X19 data.quad(v.address("(*((*(\\Sec\Global\UefiInfoBlockPtr)).CrashContext.SystemContextAArch64)).X19"))
  r.s  X20 data.quad(v.address("(*((*(\\Sec\Global\UefiInfoBlockPtr)).CrashContext.SystemContextAArch64)).X20"))
  r.s  X21 data.quad(v.address("(*((*(\\Sec\Global\UefiInfoBlockPtr)).CrashContext.SystemContextAArch64)).X21"))
  r.s  X22 data.quad(v.address("(*((*(\\Sec\Global\UefiInfoBlockPtr)).CrashContext.SystemContextAArch64)).X22"))
  r.s  X23 data.quad(v.address("(*((*(\\Sec\Global\UefiInfoBlockPtr)).CrashContext.SystemContextAArch64)).X23"))
  r.s  X24 data.quad(v.address("(*((*(\\Sec\Global\UefiInfoBlockPtr)).CrashContext.SystemContextAArch64)).X24"))
  r.s  X25 data.quad(v.address("(*((*(\\Sec\Global\UefiInfoBlockPtr)).CrashContext.SystemContextAArch64)).X25"))
  r.s  X26 data.quad(v.address("(*((*(\\Sec\Global\UefiInfoBlockPtr)).CrashContext.SystemContextAArch64)).X26"))
  r.s  X27 data.quad(v.address("(*((*(\\Sec\Global\UefiInfoBlockPtr)).CrashContext.SystemContextAArch64)).X27"))
  r.s  X28 data.quad(v.address("(*((*(\\Sec\Global\UefiInfoBlockPtr)).CrashContext.SystemContextAArch64)).X28"))
  
  ; Restore SPRS
  r.s  X29 data.quad(v.address("(*((*(\\Sec\Global\UefiInfoBlockPtr)).CrashContext.SystemContextAArch64)).FP"))
  r.s  X30 data.quad(v.address("(*((*(\\Sec\Global\UefiInfoBlockPtr)).CrashContext.SystemContextAArch64)).LR"))
  r.s   SP data.quad(v.address("(*((*(\\Sec\Global\UefiInfoBlockPtr)).CrashContext.SystemContextAArch64)).SP"))
  r.s   PC data.quad(v.address("(*((*(\\Sec\Global\UefiInfoBlockPtr)).CrashContext.SystemContextAArch64)).ELR"))

  